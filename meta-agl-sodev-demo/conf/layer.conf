## meta-agl-sodev-demo/conf/layer.conf
```bitbake
# We have a conf and classes directory, add to BBPATH
BBPATH =. "${LAYERDIR}:"

# We have recipes-* directories, add to BBFILES
BBFILES += "${LAYERDIR}/recipes-*/*/*.bb \
            ${LAYERDIR}/recipes-*/*/*.bbappend"

BBFILE_COLLECTIONS += "agl-sodev-demo-layer"
BBFILE_PATTERN_agl-sodev-demo-layer = "^${LAYERDIR}/"
BBFILE_PRIORITY_agl-sodev-demo-layer = "70"

BBFILES_DYNAMIC += " \
    raspberrypi:${LAYERDIR}/dynamic-layers/meta-raspberrypi/*/*/*.bb \
    raspberrypi:${LAYERDIR}/dynamic-layers/meta-raspberrypi/*/*/*.bbappend \
    sparrow-hawk:${LAYERDIR}/dynamic-layers/meta-sparrow-hawk/recipes-*/*/*.bb \
    sparrow-hawk:${LAYERDIR}/dynamic-layers/meta-sparrow-hawk/recipes-*/*/*.bbappend \
"

LAYERSERIES_COMPAT_agl-sodev-demo-layer = "wrynose"

LAYERDEPENDS_agl-sodev-demo-layer = "agl-sodev agl-sodev-platform agldemo virtualization-layer"
```
